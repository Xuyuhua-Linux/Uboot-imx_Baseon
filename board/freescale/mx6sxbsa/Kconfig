## board/freescale/mx6sxbsa/Kconfig
```kconfig
if TARGET_MX6SXBSA

config SYS_BOARD
	default "mx6sxbsa"

config SYS_VENDOR
	default "freescale"

config SYS_SOC
	default "mx6"

config SYS_CONFIG_NAME
	default "mx6sxbsa"

endif
```
